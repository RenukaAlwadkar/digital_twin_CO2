## qemu-esp32/firmware/dummy-node/sdkconfig.defaults
```kconfig
CONFIG_IDF_TARGET="esp32"
CONFIG_ESP_MAIN_TASK_STACK_SIZE=8192
CONFIG_LOG_DEFAULT_LEVEL_INFO=y
CONFIG_MQTT_PROTOCOL_311=y
CONFIG_EXAMPLE_CONNECT_ETHERNET=y
CONFIG_ETH_USE_OPENETH=y
```
